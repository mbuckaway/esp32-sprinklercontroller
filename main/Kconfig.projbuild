## main/Kconfig.projbuild
```kconfig
menu "Homekit Configuration"

    config HOMEKIT_USE_HARDCODED_SETUP_CODE
        bool "Use hard-coded setup code"
        default y
        help
            HomeKit does not recommend having the setup code programmed in the accessory as is.
            Instead, it expects setup info (salt-verifier pair) generated for the given setup code.
            Use this option only for testing purposes. For production, the setup info should be
            used.

    config HOMEKIT_SETUP_CODE
        string "HomeKit Setup Code"
        default "111-22-333"
        depends on HOMEKIT_USE_HARDCODED_SETUP_CODE
        help
            Setup code to be used for HomeKot pairing, if hard-coded setup code is enabled.

    config HOMEKIT_SETUP_ID
        string "HomeKit Setup Id"
        default "ES32"
        depends on HOMEKIT_USE_HARDCODED_SETUP_CODE
        help
            Setup id to be used for HomeKot pairing, if hard-coded setup code is enabled.

endmenu

menu "Sprinkler GPIO Configuration"
    config GPIO_OUTPUT_IO_RELAY_ZONE1
        int "GPIO PIN for relay on Zone1"
        default 26
        range 1 34
        help
            GPIO number (IOxx) to control the zone 1 relay
            GPIOs 35-39 are input-only so cannot be used as outputs.
        
    config GPIO_OUTPUT_IO_RELAY_ZONE2
        int "GPIO PIN for relay on zone2"
        default 27
        range 1 39
        help
            GPIO number (IOxx) to control the zone 2 relay
            Input is active low (pulled to ground when switch closed)

    config GPIO_OUTPUT_IO_RELAY_MASTER
        int "GPIO PIN for relay on master value"
        default 25
        range 1 39
        help
            GPIO number (IOxx) to control the master relay
            Input is active low (pulled to ground when switch closed)


endmenu
```
